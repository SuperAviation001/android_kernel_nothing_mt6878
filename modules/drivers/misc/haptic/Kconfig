## modules/drivers/misc/haptic/Kconfig
```kconfig
#
# ICS_HAPTIC_DRV Driver
#

config HAPTIC_DRV
	tristate "HAPTIC_DRV driver"
	default m
	depends on I2C
	help
	  Say Y here if you have AAC/ICS RT6010 haptic controller
	  chip in your system.
	  If unsure, say N.
	  To compile this driver as a module, choose M here: the
	  module will be called aac_haptic_drv.

config HAPTIC_DRV_RICHTAP
	tristate "HAPTIC_DRV richtap driver"
	depends on HAPTIC_DRV
	help
	  Say Y here if you want to enable aac_richtap device for
	  the AAC RT6010 haptic controller.
```
